// generated by mBlock5 for mBot
// codes make you happy

#include <MeMCore.h>
#include <Arduino.h>
#include <Wire.h>
#include <SoftwareSerial.h>

MeUltrasonicSensor ultrasonic_3(3);
MeDCMotor motor_9(9);
MeDCMotor motor_10(10);

void move(int direction, int speed) {
  //funzione movimento INPUT direction da 1 a 4, speed da -255 a 255 (bit)
  int leftSpeed = 0;
  int rightSpeed = 0;
  if(direction == 1) {
    //avanti
    leftSpeed = speed;
    rightSpeed = speed;
  } else if(direction == 2) {
    //indietro
    leftSpeed = -speed;
    rightSpeed = -speed;
  } else if(direction == 3) {
    //sinistra
    leftSpeed = -speed;
    rightSpeed = speed;
  } else if(direction == 4) {
    //destra
    leftSpeed = speed;
    rightSpeed = -speed;
  }
  motor_9.run((9) == M1 ? -(leftSpeed) : (leftSpeed));
  motor_10.run((10) == M1 ? -(rightSpeed) : (rightSpeed));
}

void _delay(float seconds) {
  long endTime = millis() + seconds * 1000;
  while(millis() < endTime) _loop();
}

void setup() {
  pinMode(A7, INPUT);
  while(!((0 ^ (analogRead(A7) > 10 ? 0 : 1))))
  {
    _loop();
  }
  while(1) {
      if(ultrasonic_3.distanceCm() > 10){

          move(1, 50 / 100.0 * 255);

      }else{

          move(4, 50 / 100.0 * 255);
          _delay(1);

      }

      _loop();
  }

}

void _loop() {
}

void loop() {
  _loop();
}
